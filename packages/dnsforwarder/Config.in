## packages/dnsforwarder/Config.in
```kconfig
menu "Dnsforwarder-5 configuration"
	depends on PACKAGE_dnsforwarder-5

choice
	prompt "Downloader"
	default ENABLE_DOWNLOADER_LIBCURL

config ENABLE_DOWNLOADER_LIBCURL
	bool "Libcurl"

config ENABLE_DOWNLOADER_WGET
	bool "Wget"

endchoice

choice
	prompt "Base64decoder"
	default ENABLE_BASE64_OPENSSL

config ENABLE_BASE64_OPENSSL
	bool "openssl"

config ENABLE_BASE64_UUDECODE
	bool "uudecode"

endchoice

config ENABLE_STATIC
	bool "Enable static"
	default N

endmenu
```

## packages/ngrokc/Config.in
```kconfig
choice
	prompt "Selected SSL library"
	default NGROKC_POLARSSL

	config NGROKC_POLARSSL
		bool "PolarSSL"

	config NGROKC_OPENSSL
		bool "OpenSSL"

endchoice
```

## packages/redsocks2-alt/Config.in
```kconfig
choice
	prompt "Selected SSL library"
	default REDSOCKS2_POLARSSL

	config REDSOCKS2_POLARSSL
		bool "PolarSSL"

	config REDSOCKS2_OPENSSL
		bool "OpenSSL"

endchoice
```

## packages/shadowsocks-libev-ra/Config.in
```kconfig
if PACKAGE_shadowsocks-libev || PACKAGE_shadowsocks-libev-server

comment "SSL support"

choice
	prompt "Selected SSL library"
	default SHADOWSOCKS_LIBEV_POLARSSL

	config SHADOWSOCKS_LIBEV_POLARSSL
		bool "PolarSSL"

	config SHADOWSOCKS_LIBEV_OPENSSL
		bool "OpenSSL"

	config SHADOWSOCKS_LIBEV_MBEDTLS
		bool "MbedTLS"

endchoice

endif
```
